## config/config/boards/shields/yellowjacket/Kconfig.shield
```kconfig
# Copyright (c) 2020 The ZMK Contributors
# SPDX-License-Identifier: MIT

config SHIELD_YELLOWJACKET_LEFT
	def_bool $(shields_list_contains,yellowjacket_left)

config SHIELD_YELLOWJACKET_RIGHT
	def_bool $(shields_list_contains,yellowjacket_right)
```
